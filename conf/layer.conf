## conf/layer.conf
```bitbake
# We have a conf and classes directory, add to BBPATH
BBPATH .= ":${LAYERDIR}"

# We have recipes-* directories, add to BBFILES
BBFILES += "${LAYERDIR}/recipes-*/*/*.bb \
            ${LAYERDIR}/recipes-*/*/*.bbappend"

BBFILE_COLLECTIONS += "meta-cluster7inch-uag"
BBFILE_PATTERN_meta-cluster7inch-uag = "^${LAYERDIR}/"
BBFILE_PRIORITY_meta-cluster7inch-uag = "6"

LAYERDEPENDS_meta-cluster7inch-uag = "core"
LAYERSERIES_COMPAT_meta-cluster7inch-uag = "scarthgap"
```
